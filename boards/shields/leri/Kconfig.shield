## boards/shields/leri/Kconfig.shield
```kconfig
config SHIELD_LERI_LEFT
	def_bool $(shields_list_contains,leri_left)

config SHIELD_LERI_RIGHT
	def_bool $(shields_list_contains,leri_right)
```

## config/boards/shields/leri/Kconfig.defconfig
```kconfig
if SHIELD_LERI_LEFT

config ZMK_KEYBOARD_NAME
	default "Leri"

config ZMK_SPLIT_BLE_ROLE_CENTRAL
	default y

endif

if SHIELD_LERI_LEFT || SHIELD_LERI_RIGHT

config ZMK_SPLIT
	default y
	
endif
```

## config/boards/shields/leri/Kconfig.shield
```kconfig
config LERI_LEFT
    def_bool $(shields_list_contains,leri_left)

config LERI_RIGHT
    def_bool $(shields_list_contains,leri_right)
```
